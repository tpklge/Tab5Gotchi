## main/Kconfig.projbuild
```kconfig
menu "Bichinhos do Tab5"
config GOTCHI_BREEDING
    bool "Reprodução e herança local"
    default n
    help
        Habilita escolha de dois perfis adultos para criar ovo no terceiro perfil livre.
config GOTCHI_LAN
    bool "Visitas e presentes em rede local"
    default n
    help
        Requer variante de build com ESP-Hosted 2.13.1 e esp_wifi_remote 1.6.5.
        Nunca depende de cloud, conta ou internet.
endmenu
```

## sdkconfig.defaults
```kconfig
CONFIG_IDF_TARGET="esp32p4"
CONFIG_IDF_EXPERIMENTAL_FEATURES=y
CONFIG_ESPTOOLPY_FLASHSIZE_16MB=y
CONFIG_SPIRAM=y
CONFIG_SPIRAM_MALLOC_ALWAYSINTERNAL=512
CONFIG_PARTITION_TABLE_CUSTOM=y
CONFIG_PARTITION_TABLE_CUSTOM_FILENAME="partitions.csv"
CONFIG_ESP_CONSOLE_USB_SERIAL_JTAG=y
CONFIG_ESP_MAIN_TASK_STACK_SIZE=24576
CONFIG_COMPILER_OPTIMIZATION_SIZE=y
CONFIG_BSP_ERROR_CHECK=n
CONFIG_BSP_I2C_NUM=0
CONFIG_FATFS_LFN_HEAP=y
CONFIG_FATFS_MAX_LFN=128
CONFIG_FATFS_FS_LOCK=32
CONFIG_LV_FONT_MONTSERRAT_20=n
# CONFIG_LV_FONT_MONTSERRAT_28 is not set
CONFIG_LV_USE_FS_STDIO=y
CONFIG_LV_FS_STDIO_LETTER=83
CONFIG_LV_FS_STDIO_PATH="/sdcard"
CONFIG_LV_USE_BMP=y
CONFIG_LV_USE_FONT_COMPRESSED=y
CONFIG_LV_USE_SNAPSHOT=y

CONFIG_LV_USE_BUILTIN_MALLOC=n
CONFIG_LV_USE_CLIB_MALLOC=y

CONFIG_LV_FONT_DEFAULT_MONTSERRAT_20=n
CONFIG_LV_FONT_DEFAULT_MONTSERRAT_14=y
CONFIG_LV_FONT_MONTSERRAT_14=y
```
